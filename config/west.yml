## config/west.yml
```yaml
manifest:
  remotes:
    - name: uniqly
      url-base: https://github.com/uniqly
  projects:
    - name: zmk
      remote: uniqly
      revision: main
      import: app/west.yml
  self:
    path: config
```
